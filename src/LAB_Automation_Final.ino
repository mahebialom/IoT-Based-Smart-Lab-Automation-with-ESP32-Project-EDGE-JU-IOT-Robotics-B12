#define BLYNK_TEMPLATE_ID "TMPL6Q1LPWIac"
#define BLYNK_TEMPLATE_NAME "Quickstart Template"
#define BLYNK_AUTH_TOKEN "sExMslAPbgyWfjFDaxYcW7co9cTMlFeZ"

char ssid[] = "IIT-JU-DLAB";
char pass[] = "iitju1239";

#include <WiFi.h>
#include <WiFiClient.h>
#include <BlynkSimpleEsp32.h>
#include <DHT.h>  
#include <IRremote.h>
#include <Wire.h>
#include <Adafruit_GFX.h>
#include <Adafruit_SH1106.h>
#include <Fonts/FreeMonoBold18pt7b.h>
#include <Fonts/FreeSans9pt7b.h>  


#define DHTPIN 26
#define DHTTYPE DHT11  
DHT dht(DHTPIN, DHTTYPE);
int h;
int t;
#define SCREEN_WIDTH 128 
#define SCREEN_HEIGHT 64 
#define OLED_RESET     19 
#define OLED_SDA 21
#define OLED_SCL 22

Adafruit_SH1106 display(21,22);


#define FRAME_DELAY (42)
#define FRAME_WIDTH (48)
#define FRAME_HEIGHT (48)
#define FRAME_COUNT (sizeof(frames) / sizeof(frames[0]))
const byte PROGMEM frames[][288] = {
  {0,0,0,0,32,0,0,0,0,0,96,0,0,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0,0},
  {0,0,0,0,32,0,0,0,0,0,48,0,0,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0,0},
  {0,0,0,0,16,0,0,0,0,0,48,0,0,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0,0},
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  {0,0,0,0,96,0,0,0,0,0,96,0,0,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0,0}
};



#define bitmap_height   128
#define bitmap_width    64
static const unsigned char PROGMEM logo_bmp[] =
{ 0x00, 0x00, 0x00, 0x00, 0xFF, 0x80, 0x00, 0x00, 0x00, 0x00, 0x00, 0x00, 0x00, 0x00, 0x00, 0x00,
  0x00, 0x00, 0x00, 0x00, 0x3F, 0x80, 0x00, 0x00, 0x00, 0x00, 0x00, 0x00, 0x00, 0x00, 0x00, 0x00,
  0x00, 0x00, 0x00, 0x00, 0x1F, 0xC0, 0x00, 0x00, 0x00, 0x00, 0x00, 0x00, 0x00, 0x00, 0x00, 0x00,
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  0x00, 0x03, 0xE0, 0x00, 0x00, 0x00, 0x00, 0x00, 0x00, 0x00, 0x00, 0x00, 0x00, 0x00, 0x00, 0x00
};


#define RelayPin1 15
#define RelayPin2 16
#define RelayPin3 17
#define RelayPin4 18


#define SwitchPin1 13
#define SwitchPin2 12
#define SwitchPin3 14
#define SwitchPin4 27

#define wifiLed   2
#define IR_RECEIVER_PIN   25 
#define LED_FEEDBACK_PIN 2
#define pir_pin   4


#define VPIN_BUTTON_1    V1 
#define VPIN_BUTTON_2    V2 
#define VPIN_BUTTON_3    V3 
#define VPIN_BUTTON_4    V4 
#define VPIN_BUTTON_All  V5

bool toggleState_1 = LOW;
bool toggleState_2 = LOW;
bool toggleState_3 = LOW;
bool toggleState_4 = LOW;

bool SwitchState_1 = LOW;
bool SwitchState_2 = LOW;
bool SwitchState_3 = LOW;
bool SwitchState_4 = LOW;

char auth[] = BLYNK_AUTH_TOKEN;

BlynkTimer timer;


BLYNK_WRITE(VPIN_BUTTON_1) {
  toggleState_1 = param.asInt();
  digitalWrite(RelayPin1, !toggleState_1);
}


BLYNK_WRITE(VPIN_BUTTON_2) {
  toggleState_2 = param.asInt();
  digitalWrite(RelayPin2, !toggleState_2);
}

BLYNK_WRITE(VPIN_BUTTON_3) {
  toggleState_3 = param.asInt();
  digitalWrite(RelayPin3, !toggleState_3);
}

BLYNK_WRITE(VPIN_BUTTON_4) {
  toggleState_4 = param.asInt();
  digitalWrite(RelayPin4, !toggleState_4);
}

BLYNK_WRITE(VPIN_BUTTON_All) {
  all_SwitchOff();
}

void all_SwitchOff(){
  if(toggleState_1 || toggleState_2 || toggleState_3 || toggleState_4){
  toggleState_1 = 0; digitalWrite(RelayPin1, HIGH); Blynk.virtualWrite(VPIN_BUTTON_1, toggleState_1); delay(30);
  toggleState_2 = 0; digitalWrite(RelayPin2, HIGH); Blynk.virtualWrite(VPIN_BUTTON_2, toggleState_2); delay(30);
  toggleState_3 = 0; digitalWrite(RelayPin3, HIGH); Blynk.virtualWrite(VPIN_BUTTON_3, toggleState_3); delay(30);
  toggleState_4 = 0; digitalWrite(RelayPin4, HIGH); Blynk.virtualWrite(VPIN_BUTTON_4, toggleState_4); delay(30);
  }

  else if(toggleState_1==0 && toggleState_2==0 && toggleState_3==0 && toggleState_4==0){
     toggleState_1 = 1; digitalWrite(RelayPin1, LOW); Blynk.virtualWrite(VPIN_BUTTON_1, toggleState_1); delay(30);
     toggleState_2 = 1; digitalWrite(RelayPin2, LOW); Blynk.virtualWrite(VPIN_BUTTON_2, toggleState_2); delay(30);
     toggleState_3 = 1; digitalWrite(RelayPin3, LOW); Blynk.virtualWrite(VPIN_BUTTON_3, toggleState_3); delay(30);
     toggleState_4 = 1; digitalWrite(RelayPin4, LOW); Blynk.virtualWrite(VPIN_BUTTON_4, toggleState_4); delay(30);
  }
}

void checkBlynkStatus() {

  bool isconnected = Blynk.connected();

  if (isconnected == false) {
    Serial.println("Blynk Not Connected");
    digitalWrite(wifiLed, HIGH);
  }
  else if (isconnected == true) {
    Blynk.virtualWrite(VPIN_BUTTON_1, toggleState_1);
    Blynk.virtualWrite(VPIN_BUTTON_2, toggleState_2);
    Blynk.virtualWrite(VPIN_BUTTON_3, toggleState_3);
    Blynk.virtualWrite(VPIN_BUTTON_4, toggleState_4);

    digitalWrite(wifiLed, HIGH);
     timer.setTimeout(100L, []() {
        digitalWrite(wifiLed, LOW);
    });
    Serial.println("Blynk Connected");
  }
}

BLYNK_CONNECTED() {

    Blynk.syncVirtual(VPIN_BUTTON_1);
    Blynk.syncVirtual(VPIN_BUTTON_2);
    Blynk.syncVirtual(VPIN_BUTTON_3);
    Blynk.syncVirtual(VPIN_BUTTON_4);
    Blynk.syncVirtual(VPIN_BUTTON_All);
}

void irremote(){
  if (IrReceiver.decode())
    {
       digitalWrite(LED_FEEDBACK_PIN, HIGH);
        delay(40);
        digitalWrite(LED_FEEDBACK_PIN, LOW);


        Serial.print("Received Data: ");
        Serial.print(IrReceiver.decodedIRData.decodedRawData, HEX);
        Serial.print("  -  Received Command: ");
        Serial.println(IrReceiver.decodedIRData.command, HEX);

        if(IrReceiver.decodedIRData.command == 0x12){   
          all_SwitchOff();
        }

        else if(IrReceiver.decodedIRData.command == 0xA){   
          digitalWrite(RelayPin1, toggleState_1);
            toggleState_1 = !toggleState_1;
            Blynk.virtualWrite(VPIN_BUTTON_1, toggleState_1);
        }
         else if(IrReceiver.decodedIRData.command == 0x1B){   
          digitalWrite(RelayPin2, toggleState_2);
            toggleState_2 = !toggleState_2;
            Blynk.virtualWrite(VPIN_BUTTON_2, toggleState_2);
        }

         else if(IrReceiver.decodedIRData.command == 0x1F){   
          digitalWrite(RelayPin3, toggleState_3);
            toggleState_3 = !toggleState_3;
            Blynk.virtualWrite(VPIN_BUTTON_3, toggleState_3);
        }
         else if(IrReceiver.decodedIRData.command == 0xC){   
          digitalWrite(RelayPin4, toggleState_4);
            toggleState_4 = !toggleState_4;
            Blynk.virtualWrite(VPIN_BUTTON_4, toggleState_4);
        }
        delay(50);

        IrReceiver.resume();
    }
}



void manual_control()
{
  if (digitalRead(SwitchPin1) == LOW && SwitchState_1 == LOW) {
    digitalWrite(RelayPin1, LOW);
    toggleState_1 = HIGH;
    SwitchState_1 = HIGH;
    Blynk.virtualWrite(VPIN_BUTTON_1, toggleState_1);
    Serial.println("Switch-1 on");
  
}  

 if (digitalRead(SwitchPin1) == HIGH && SwitchState_1 == HIGH) {
    digitalWrite(RelayPin1, HIGH);
    toggleState_1 = LOW;
    SwitchState_1 = LOW;
    Blynk.virtualWrite(VPIN_BUTTON_1, toggleState_1);
    Serial.println("Switch-1 off");
  }



    if (digitalRead(SwitchPin2) == LOW && SwitchState_2 == LOW) {
    digitalWrite(RelayPin2, LOW);
    toggleState_2 = HIGH;
    SwitchState_2 = HIGH;
    Blynk.virtualWrite(VPIN_BUTTON_2, toggleState_2);
    Serial.println("Switch-1 on");
  
}  

 if (digitalRead(SwitchPin2) == HIGH && SwitchState_2 == HIGH) {
    digitalWrite(RelayPin2, HIGH);
    toggleState_2 = LOW;
    SwitchState_2 = LOW;
    Blynk.virtualWrite(VPIN_BUTTON_2, toggleState_2);
    Serial.println("Switch-1 off");
  }



  if (digitalRead(SwitchPin3) == LOW && SwitchState_3 == LOW) {
    digitalWrite(RelayPin3, LOW);
    toggleState_3 = HIGH;
    SwitchState_3 = HIGH;
    Blynk.virtualWrite(VPIN_BUTTON_3, toggleState_3);
    Serial.println("Switch-1 on");
  
}  

 if (digitalRead(SwitchPin3) == HIGH && SwitchState_3 == HIGH) {
    digitalWrite(RelayPin3, HIGH);
    toggleState_3 = LOW;
    SwitchState_3 = LOW;
    Blynk.virtualWrite(VPIN_BUTTON_3, toggleState_3);
    Serial.println("Switch-1 off");
  }



  if (digitalRead(SwitchPin4) == LOW && SwitchState_4 == LOW) {
    digitalWrite(RelayPin4, LOW);
    toggleState_4 = HIGH;
    SwitchState_4 = HIGH;
    Blynk.virtualWrite(VPIN_BUTTON_4, toggleState_4);
    Serial.println("Switch-1 on");
  
}  

 if (digitalRead(SwitchPin4) == HIGH && SwitchState_4 == HIGH) {
    digitalWrite(RelayPin4, HIGH);
    toggleState_4 = LOW;
    SwitchState_4 = LOW;
    Blynk.virtualWrite(VPIN_BUTTON_4, toggleState_4);
    Serial.println("Switch-1 off");
  }



}


void pir(){
    all_SwitchOff();
    delay(10000);
     all_SwitchOff();
  }

void setup()
{
  Serial.begin(115200);

  IrReceiver.begin(IR_RECEIVER_PIN, ENABLE_LED_FEEDBACK);
  pinMode(LED_FEEDBACK_PIN, OUTPUT);

  pinMode(RelayPin1, OUTPUT);
  pinMode(RelayPin2, OUTPUT);
  pinMode(RelayPin3, OUTPUT);
  pinMode(RelayPin4, OUTPUT);

  pinMode(wifiLed, OUTPUT);

  pinMode(SwitchPin1, INPUT_PULLUP);
  pinMode(SwitchPin2, INPUT_PULLUP);
  pinMode(SwitchPin3, INPUT_PULLUP);
  pinMode(SwitchPin4, INPUT_PULLUP);

  pinMode(pir_pin, INPUT);


  toggleState_1 = !digitalRead(SwitchPin1);
  toggleState_2 = !digitalRead(SwitchPin2);
  toggleState_3 = !digitalRead(SwitchPin3);
  toggleState_4 = !digitalRead(SwitchPin4);

  digitalWrite(RelayPin1, toggleState_1 ? LOW : HIGH);
  digitalWrite(RelayPin2, toggleState_2 ? LOW : HIGH);
  digitalWrite(RelayPin3, toggleState_3 ? LOW : HIGH);
  digitalWrite(RelayPin4, toggleState_4 ? LOW : HIGH);


  WiFi.begin(ssid, pass);
  Blynk.config(auth);
  timer.setInterval(15000L, checkBlynkStatus);
  delay(1000);
  Blynk.virtualWrite(VPIN_BUTTON_1, toggleState_1);
  Blynk.virtualWrite(VPIN_BUTTON_2, toggleState_2);
  Blynk.virtualWrite(VPIN_BUTTON_3, toggleState_3);
  Blynk.virtualWrite(VPIN_BUTTON_4, toggleState_4);


  display.begin(SH1106_SWITCHCAPVCC, 0x3C);
  dht.begin();


 display.clearDisplay();             

  display.setFont(&FreeSans9pt7b);
  display.setTextColor(WHITE);
  display.setCursor(0, 20);         
  display.print(F("Powered by"));


  display.setFont(&FreeMonoBold18pt7b);
  display.setCursor(10, 50);           
  display.print(F("CSEJU"));

  display.display();                  
  delay(3000);                         



 display.clearDisplay();                

  display.setFont(&FreeSans9pt7b);
  display.setTextColor(WHITE);
  display.setCursor(0, 20);          
  display.print(F("Designed By"));

  display.setFont(&FreeMonoBold18pt7b);
  display.setCursor(10, 50);        
  display.print(F("Dipu"));

  display.display();            
  delay(2000); 



int frame = 0;
 for(int i=0 ;i <50;i++){
  display.clearDisplay();
  display.drawBitmap(40, 8, frames[frame], FRAME_WIDTH, FRAME_HEIGHT, 1);
  display.display();
  frame = (frame + 1) % FRAME_COUNT;
  delay(FRAME_DELAY);
 }

}

void loop()
{ 
  manual_control();
  irremote();
  Blynk.run();
  timer.run();
  // if(digitalRead(pir_pin)==1 && toggleState_1==0 && toggleState_2==0 && toggleState_3==0 && toggleState_4==0){
  //    pir();
  // }

   display.clearDisplay(); 



  h = dht.readHumidity();
  t = dht.readTemperature();

  showBitmap();
  printText();
  display.display();
  delay(200);
  display.clearDisplay();
 
}

void printText() {
  display.setFont(&FreeMonoBold18pt7b);
  display.setTextColor(WHITE);   
  display.setCursor(50, 28);   
  display.print(t);
  display.drawCircle(97, 8, 3, WHITE);
  display.setCursor(100, 27);
  display.print(F("C"));
  display.setCursor(50, 62);
  display.print(h);
  display.setCursor(100, 62);
  display.print(F("%"));
}
void showBitmap(void) {
  display.drawBitmap(0, 0, logo_bmp, bitmap_height, bitmap_width, WHITE);
  //display.display();
}
